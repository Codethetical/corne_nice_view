## app/boards/shields/corne_nice_view/Kconfig.defconfig
```kconfig
if SHIELD_CORNE_NICE_VIEW_LEFT

config ZMK_KEYBOARD_NAME
    default "Corne Nice View"

config ZMK_SPLIT_ROLE_CENTRAL
    default y

if ZMK_DISPLAY

config LV_FONT_MONTSERRAT_18
    default y

config LV_FONT_MONTSERRAT_14
    default y

config LV_FONT_UNSCII_8
    default y

config ZMK_WPM
    default y

endif # ZMK_DISPLAY

endif

if SHIELD_CORNE_NICE_VIEW_LEFT || SHIELD_CORNE_NICE_VIEW_RIGHT

config ZMK_SPLIT
    default y

if ZMK_DISPLAY

config I2C
    default y

config SSD1306
    default y

config LV_USE_CANVAS
    default y

config LV_USE_IMAGE
    default y

config LV_FONT_MONTSERRAT_16
    default y

config LV_FONT_MONTSERRAT_12
    default y

endif # ZMK_DISPLAY

if LVGL

config LV_Z_VDB_SIZE
    default 64

config LV_DPI_DEF
    default 148

config LV_Z_BITS_PER_PIXEL
    default 1

choice LV_COLOR_DEPTH
    default LV_COLOR_DEPTH_1
endchoice

endif # LVGL

endif
```

## app/boards/shields/corne_nice_view/Kconfig.shield
```kconfig
# Copyright (c) 2020 Pete Johanson
# SPDX-License-Identifier: MIT

config SHIELD_CORNE_NICE_VIEW_LEFT
    def_bool $(shields_list_contains,corne_nice_view_left)

config SHIELD_CORNE_NICE_VIEW_RIGHT
    def_bool $(shields_list_contains,corne_nice_view_right)
```
